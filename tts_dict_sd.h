// tts_dict_sd.h
// SD-card dictionary lookup for TeensyTalk V2.
//
// Reads DICT.BIN from the SD card root — a sorted flat file of 128-byte
// fixed-width records generated by build_dict.py:
//   bytes  0-31 : word, null-padded
//   bytes 32-127: phoneme string, null-padded  (MBROLA us2 names)
//
// Binary search gives O(log n) performance: ~17 seeks for 100k entries,
// which at ~2 ms/seek is ~34 ms worst-case — well before playback starts.
//
// Call sdDictInit() once in setup(), after SD.begin().
// sdDictLookup() returns a pointer to a static buffer (valid until the
// next call) or NULL if not found.

#ifndef TTS_DICT_SD_H
#define TTS_DICT_SD_H

#define SD_DICT_FILE      "DICT.BIN"
#define SD_DICT_WORD_LEN  32
#define SD_DICT_PHONE_LEN 96
#define SD_DICT_REC_SIZE  (SD_DICT_WORD_LEN + SD_DICT_PHONE_LEN)  // 128

static File     g_sdDict;
static uint32_t g_sdDictEntries = 0;
static char     g_sdDictBuf[SD_DICT_PHONE_LEN];

// Open DICT.BIN and record the entry count.  Call once after SD.begin().
static bool sdDictInit() {
    g_sdDict = SD.open(SD_DICT_FILE);
    if (!g_sdDict) {
        Serial.println("DICT.BIN not found — using built-in dict only");
        return false;
    }
    g_sdDictEntries = g_sdDict.size() / SD_DICT_REC_SIZE;
    Serial.print("SD dict loaded: ");
    Serial.print(g_sdDictEntries);
    Serial.println(" entries");
    return true;
}

// Binary search DICT.BIN for word.  Returns phoneme string or NULL.
static const char* sdDictLookup(const char* word) {
    if (!g_sdDict || g_sdDictEntries == 0) return NULL;

    char key[SD_DICT_WORD_LEN];
    uint32_t lo = 0, hi = g_sdDictEntries;

    while (lo < hi) {
        uint32_t mid = lo + (hi - lo) / 2;
        g_sdDict.seek((uint32_t)mid * SD_DICT_REC_SIZE);
        g_sdDict.read(key, SD_DICT_WORD_LEN);

        int cmp = strcmp(word, key);
        if (cmp == 0) {
            g_sdDict.read(g_sdDictBuf, SD_DICT_PHONE_LEN);
            return g_sdDictBuf;
        } else if (cmp < 0) {
            hi = mid;
        } else {
            lo = mid + 1;
        }
    }
    return NULL;
}

#endif // TTS_DICT_SD_H
